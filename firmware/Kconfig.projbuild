## firmware/Kconfig.projbuild
```kconfig
# Weather Station Kconfig

menu "Weather Station Configuration"

config MESH_TEST_MODE
    bool "Enable Mesh Test Mode (standalone sender/listener)"
    default n
    help
      Enable standalone mesh test mode. This replaces the normal
      sensor/ML + mesh operation with a simple two-node test:
      one node sends test packets, the other receives and verifies
      decryption. Useful for bring-up and range testing.

config MESH_TEST_ROLE
    string "Mesh Test Role"
    depends on MESH_TEST_MODE
    default "sender"
    help
      Select node role in test mode: "sender" or "listener".
      Flash one board with "sender", the other with "listener".

endmenu
```
